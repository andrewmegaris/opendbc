VERSION ""

NS_ :

BS_:

BU_: XXX

BO_ 1056 NEW_MSG_2: 8 XXX

BO_ 1072 NEW_MSG_3: 8 XXX
 SG_ NEW_SIGNAL_1 : 15|8@0+ (1,0) [0|255] "" XXX

BO_ 1279 NEW_MSG_4: 8 XXX
 SG_ NEW_SIGNAL_1 : 15|56@0+ (1,0) [0|72057594037927940] "" XXX

BO_ 1107 NEW_MSG_1: 8 XXX
 SG_ NEW_SIGNAL_1 : 7|64@0+ (1,0) [0|18446744073709552000] "" XXX

BO_ 512 Pedal Information: 8 XXX
 SG_ Accel Pedal? : 63|8@0+ (1,0) [0|255] "" XXX
 SG_ Brake Engaged? : 48|1@0+ (1,0) [0|1] "" XXX
